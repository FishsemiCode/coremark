## Kconfig
```kconfig
#
# For a description of the syntax of this configuration file,
# see the file kconfig-language.txt in the NuttX tools repository.
#

config EXTERNAL_TOOLS_COREMARK
	bool "CoreMark Processor Benchmark"
	default n
	---help---
		Enable the CoreMark Processor Benchmark

if EXTERNAL_TOOLS_COREMARK

config EXTERNAL_TOOLS_COREMARK_ITERATIONS
	int "CoreMark iterations loop counter"
	default 0

config EXTERNAL_TOOLS_COREMARK_SEED_METHOD
	int "CoreMark Seed Method"
	default 2 if EXTERNAL_TOOLS_COREMARK_RUN_METHOD
	default 0 if !EXTERNAL_TOOLS_COREMARK_RUN_METHOD
	---help---
		Set CoreMark Seed Method:
		0 : SEED_ARG
		1 : SEED_FUNC
		2 : SEED_VOLATILE

config EXTERNAL_TOOLS_COREMARK_MEM_METHOD
	int "CoreMark Memory Method"
	default 1
	---help---
		Set CoreMark Memory Method:
		0 : MEM_STATIC
		1 : MEM_MALLOC
		2 : MEM_STACK

config EXTERNAL_TOOLS_COREMARK_DEBUG
	int "CoreMark Core Debug"
	default 0
	---help---
		Enable the Core Debug:
		0 : Disable
		1 : Enable

config EXTERNAL_TOOLS_COREMARK_RUN_METHOD
	int "CoreMark Run Method"
	default 0
	---help---
		Enable the Run Method:
		0 : VALIDATION_RUN
		1 : PERFORMANCE_RUN
		2 : PROFILE_RUN

config EXTERNAL_TOOLS_COREMARK_MULTITHREAD
	int "CoreMark Multithread counter"
	default 1

endif
```
